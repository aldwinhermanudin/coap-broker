/dts-v1/;
/plugin/;

/ {
        compatible = "brcm,bcm2835", "brcm,bcm2836", "brcm,bcm2708", "brcm,bcm2709";

        fragment@0 {
                target = <&spi0>;
                __overlay__ {
                        #address-cells = <1>;
                        #size-cells = <0>;
                        status = "okay";

                        mrf24j40@0 {
                                status = "okay";
                                compatible = "mrf24j40";
                                spi-max-frequency = <5000000>;
                                reg = <1>;
                                interrupts = <23 8>;
                                interrupt-parent = <&gpio>;
                        };

                        spidev@1 {
                                status = "disabled";
                        };
                };
        };
};
